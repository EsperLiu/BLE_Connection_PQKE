## CMakeLists.txt
```
cmake_minimum_required(VERSION 3.20.0)

find_package(Zephyr REQUIRED HINTS $ENV{ZEPHYR_BASE})
project(connection_pqke)

target_include_directories(app PRIVATE
    include
    include/mlkem512
)

file(GLOB MLKEM_SOURCES
    include/mlkem512/*.c
)

target_sources(app PRIVATE
    src/main.c
    src/ble_service.c
    src/pqke_crypto.c
    src/pqke_state.c
    src/pqke_transfer.c
    src/debug_utils.c
    ${MLKEM_SOURCES}
)
```

## prj.conf
```kconfig
CONFIG_HEAP_MEM_POOL_SIZE=40000
CONFIG_MAIN_STACK_SIZE=40000
CONFIG_TEST_RANDOM_GENERATOR=y

CONFIG_BT=y
#CONFIG_BT_DEBUG_LOG=n
CONFIG_BT_SMP=n
CONFIG_BT_SIGNING=n
CONFIG_BT_PERIPHERAL=y
CONFIG_BT_ATT_PREPARE_COUNT=25
CONFIG_BT_PRIVACY=n
CONFIG_BT_DEVICE_NAME="CPQKE"
CONFIG_BT_DEVICE_APPEARANCE=0
# CONFIG_BT_DEVICE_NAME_MAX=65
# CONFIG_BT_CTLR_TX_PWR_PLUS_8=y
# CONFIG_BT_CTLR_TX_PWR_MINUS_40=y

CONFIG_BT_L2CAP_TX_MTU=407
CONFIG_BT_BUF_ACL_RX_SIZE=407
# CONFIG_BT_BUF_ACL_TX_SIZE=251
# CONFIG_BT_CTLR_DATA_LENGTH_MAX=251

CONFIG_BT_ATT_PREPARE_COUNT=8
```

## src/main.c
```c
#include <zephyr/bluetooth/bluetooth.h>
#include <zephyr/sys/printk.h>

#include "ble_service.h"

int main(void)
{
    int err = bt_enable(NULL);
    if (err) {
        printk("Bluetooth init failed (err %d)\n", err);
        return 0;
    }

    err = ble_service_init();
    if (err) {
        return 0;
    }

    return 0;
}
```

## include/ble_service.h
```c
#ifndef BLE_SERVICE_H
#define BLE_SERVICE_H

#include <stdint.h>

#include <zephyr/bluetooth/gatt.h>

int ble_service_init(void);
int ble_service_notify_cp(uint8_t value);
int ble_service_disconnect(void);
const struct bt_gatt_attr *ble_service_public_key_indicate_attr(void);

#endif /* BLE_SERVICE_H */
```

## include/debug_utils.h
```c
#ifndef DEBUG_UTILS_H
#define DEBUG_UTILS_H

#include <stddef.h>
#include <stdint.h>

void debug_print_bytes(const uint8_t *buf, size_t len);

#endif /* DEBUG_UTILS_H */
```

## include/opcodes.h
```c
#ifndef OPCODES_H
#define OPCODES_H

#define CP_IDLE        0U
#define CP_PING        1U
#define CP_INIT        2U
#define CP_KEY_READY   3U
#define CP_C_RECEIVED  4U  /* Also used as explicit CT_DONE command. */
#define CP_DECAP_DONE  5U
#define CP_ALL_DONE    6U
#define CP_ERROR       255U

#endif /* OPCODES_H */
```

## include/pqke_config.h
```c
#ifndef PQKE_CONFIG_H
#define PQKE_CONFIG_H

/* Thread configuration */
#define PQKE_OPCODE_THREAD_STACK_SIZE 40000
#define PQKE_OPCODE_THREAD_PRIORITY   7

/* Maximum public-key bytes sent in one GATT indication. */
#define PQKE_MAX_CHRC_BYTE 400

/*
 * ML-KEM security level selector:
 *   1 -> ML-KEM-512
 *   3 -> ML-KEM-768
 *   5 -> ML-KEM-1024
 */
#ifndef MLKEM_SEC_LEVEL
#define MLKEM_SEC_LEVEL 1
#endif

/* 50ms connectable advertising interval for clean DK-to-DK testing (0.625ms/unit) */
#define PQKE_ADV_INTERVAL_MIN 75
#define PQKE_ADV_INTERVAL_MAX 80

/* Optional preferred connection parameter request after connection. */
#define PQKE_CONN_INTERVAL_MIN 40      /* 50 ms */
#define PQKE_CONN_INTERVAL_MAX 40     /* 50 ms */
#define PQKE_CONN_LATENCY      0
#define PQKE_CONN_TIMEOUT      400    /* 4 s */

#endif /* PQKE_CONFIG_H */
```

## include/pqke_crypto.h
```c
#ifndef PQKE_CRYPTO_H
#define PQKE_CRYPTO_H

#include <stddef.h>
#include <stdint.h>

#include "pqke_config.h"

#if MLKEM_SEC_LEVEL == 1
#include "mlkem512/api.h"
#define PQKE_CT_FRAMES 2
#define PQKE_CT_FRAME_LEN 385
#define PQKE_CT_BYTES PQCLEAN_MLKEM512_CLEAN_CRYPTO_CIPHERTEXTBYTES
#define PQKE_PK_BYTES PQCLEAN_MLKEM512_CLEAN_CRYPTO_PUBLICKEYBYTES
#define PQKE_SK_BYTES PQCLEAN_MLKEM512_CLEAN_CRYPTO_SECRETKEYBYTES
#elif MLKEM_SEC_LEVEL == 3
#include "mlkem768/api.h"
#define PQKE_CT_FRAMES 3
#define PQKE_CT_FRAME_LEN 364
#define PQKE_CT_BYTES PQCLEAN_MLKEM768_CLEAN_CRYPTO_CIPHERTEXTBYTES
#define PQKE_PK_BYTES PQCLEAN_MLKEM768_CLEAN_CRYPTO_PUBLICKEYBYTES
#define PQKE_SK_BYTES PQCLEAN_MLKEM768_CLEAN_CRYPTO_SECRETKEYBYTES
#elif MLKEM_SEC_LEVEL == 5
#include "mlkem1024/api.h"
#define PQKE_CT_FRAMES 4
#define PQKE_CT_FRAME_LEN 393
#define PQKE_CT_BYTES PQCLEAN_MLKEM1024_CLEAN_CRYPTO_CIPHERTEXTBYTES
#define PQKE_PK_BYTES PQCLEAN_MLKEM1024_CLEAN_CRYPTO_PUBLICKEYBYTES
#define PQKE_SK_BYTES PQCLEAN_MLKEM1024_CLEAN_CRYPTO_SECRETKEYBYTES
#else
#error "Unsupported MLKEM_SEC_LEVEL. Use 1, 3, or 5."
#endif

#define PQKE_SS_BYTES 32

int pqke_crypto_generate_keypair(void);
int pqke_crypto_decapsulate(const uint8_t *ciphertext);

const uint8_t *pqke_crypto_public_key(void);
size_t pqke_crypto_public_key_len(void);

uint8_t *pqke_crypto_ciphertext_buffer(void);
size_t pqke_crypto_ciphertext_len(void);

const uint8_t *pqke_crypto_shared_secret(void);
size_t pqke_crypto_shared_secret_len(void);

#endif /* PQKE_CRYPTO_H */
```

## include/pqke_state.h
```c
#ifndef PQKE_STATE_H
#define PQKE_STATE_H

#include <stdint.h>

void pqke_state_set_cp(uint8_t new_value);
uint8_t pqke_state_get_cp(void);
void pqke_state_reset_to_idle_no_notify(void);
void pqke_opcode_thread(void);

#endif /* PQKE_STATE_H */
```

## include/pqke_transfer.h
```c
#ifndef PQKE_TRANSFER_H
#define PQKE_TRANSFER_H

#include <stddef.h>
#include <stdint.h>
#include <sys/types.h>

int pqke_transfer_deliver_public_key(void);
ssize_t pqke_transfer_write_ciphertext_frame(const void *buf, uint16_t len, uint16_t offset, uint8_t flags);

#endif /* PQKE_TRANSFER_H */
```

## src/ble_service.c
```c
#include "ble_service.h"

#include <errno.h>
#include <string.h>

#include <zephyr/kernel.h>
#include <zephyr/settings/settings.h>
#include <zephyr/sys/printk.h>
#include <zephyr/sys/util.h>
#include <zephyr/bluetooth/bluetooth.h>
#include <zephyr/bluetooth/conn.h>
#include <zephyr/bluetooth/hci.h>
#include <zephyr/bluetooth/uuid.h>
#include <zephyr/bluetooth/gatt.h>

#include "opcodes.h"
#include "pqke_config.h"
#include "pqke_crypto.h"
#include "pqke_state.h"
#include "pqke_transfer.h"

#define LOG(fmt, ...) \
    printk("[%8u ms] [BLE] " fmt "\n", (uint32_t)k_uptime_get(), ##__VA_ARGS__)

#define DEVICE_NAME CONFIG_BT_DEVICE_NAME
#define DEVICE_NAME_LEN (sizeof(DEVICE_NAME) - 1)

#define BT_UUID_CUSTOM_SERVICE_VAL \
    BT_UUID_128_ENCODE(0x12345678, 0x1234, 0x5678, 0x1234, 0x56789abcdef0)

static const uint8_t pqke_service_uuid_ad[16] = {
    0xf0, 0xde, 0xbc, 0x9a,
    0x78, 0x56,
    0x34, 0x12,
    0x78, 0x56,
    0x34, 0x12,
    0x78, 0x56, 0x34, 0x12
};


static struct bt_conn *current_conn;
static uint8_t ind_data = 1U;
static bool advertising_active;

/*
 * Radio/contact intermittence experiment.
 * The peripheral is only radio-available during RADIO_ACTIVE_WINDOW_MS.
 * At the end of each active window, advertising is stopped and any active
 * connection is forcibly disconnected. RAM is preserved; CPQKE session state
 * is reset because CPQKE is connection-bound and atomic.
 */
#define RADIO_ACTIVE_WINDOW_MS    60000
#define RADIO_INACTIVE_WINDOW_MS  0

static bool radio_window_open;
static struct k_work_delayable radio_window_end_work;
static struct k_work_delayable radio_window_start_work;

static struct bt_uuid_128 vnd_uuid = BT_UUID_INIT_128(BT_UUID_CUSTOM_SERVICE_VAL);

static const struct bt_uuid_128 cp_uuid = BT_UUID_INIT_128(
    BT_UUID_128_ENCODE(0x12345678, 0x1234, 0x5678, 0x1234, 0x56789abcde01));

static const struct bt_uuid_128 ind_uuid = BT_UUID_INIT_128(
    BT_UUID_128_ENCODE(0x12345678, 0x1234, 0x5678, 0x1234, 0x56789abcde02));

static const struct bt_uuid_128 ct_uuid = BT_UUID_INIT_128(
    BT_UUID_128_ENCODE(0x12345678, 0x1234, 0x5678, 0x1234, 0x56789abcde03));

static const struct bt_uuid_128 pqlvl_uuid = BT_UUID_INIT_128(
    BT_UUID_128_ENCODE(0x12345678, 0x1234, 0x5678, 0x1234, 0x56789abcde04));

static const struct bt_data ad[] = {
    BT_DATA_BYTES(BT_DATA_FLAGS, (BT_LE_AD_GENERAL | BT_LE_AD_NO_BREDR)),
    BT_DATA_BYTES(BT_DATA_UUID128_ALL, BT_UUID_CUSTOM_SERVICE_VAL),
};

static const struct bt_data sd[] = {
    BT_DATA(BT_DATA_NAME_COMPLETE, DEVICE_NAME, DEVICE_NAME_LEN),
};

static const struct bt_le_adv_param adv_params = {
    .options = BT_LE_ADV_OPT_CONN,
    .interval_min = PQKE_ADV_INTERVAL_MIN,
    .interval_max = PQKE_ADV_INTERVAL_MAX,
    .id = BT_ID_DEFAULT,
    .sid = 0,
};

static const struct bt_le_conn_param pqke_conn_param = {
    .interval_min = PQKE_CONN_INTERVAL_MIN,
    .interval_max = PQKE_CONN_INTERVAL_MAX,
    .latency = PQKE_CONN_LATENCY,
    .timeout = PQKE_CONN_TIMEOUT,
};

static bool ad_match_cb(struct bt_data *data, void *user_data)
{
    bool *matched = user_data;

    if (data->type == BT_DATA_UUID128_ALL ||
        data->type == BT_DATA_UUID128_SOME) {

        for (uint8_t off = 0; off + 16 <= data->data_len; off += 16) {
            if (memcmp(&data->data[off], pqke_service_uuid_ad, 16) == 0) {
                *matched = true;
                return false;
            }
        }
    }

    return true;
}

static int start_advertising(void)
{
    int err;

    if (advertising_active) {
        LOG("advertising already active");
        return 0;
    }

    LOG("starting advertising: name=%s, adv_int=[%u,%u] units", DEVICE_NAME,
        adv_params.interval_min, adv_params.interval_max);

    err = bt_le_adv_start(&adv_params, ad, ARRAY_SIZE(ad), sd, ARRAY_SIZE(sd));
    if (err) {
        LOG("advertising failed to start: err=%d", err);
        return err;
    }

    advertising_active = true;
    LOG("advertising started; service UUID advertised, name in scan response");
    return 0;
}

static int stop_advertising(void)
{
    int err;

    if (!advertising_active) {
        LOG("advertising already inactive");
        return 0;
    }

    LOG("stopping advertising");

    err = bt_le_adv_stop();
    if (err) {
        LOG("advertising stop failed: err=%d", err);
        return err;
    }

    advertising_active = false;
    LOG("advertising stopped");
    return 0;
}

static ssize_t read_cp(struct bt_conn *conn, const struct bt_gatt_attr *attr,
                       void *buf, uint16_t len, uint16_t offset)
{
    ARG_UNUSED(conn);
    ARG_UNUSED(attr);

    uint8_t value = pqke_state_get_cp();
    LOG("CP read: value=0x%02x len=%u offset=%u", value, len, offset);
    return bt_gatt_attr_read(conn, attr, buf, len, offset, &value, sizeof(value));
}

static ssize_t read_pqlvl(struct bt_conn *conn, const struct bt_gatt_attr *attr,
                          void *buf, uint16_t len, uint16_t offset)
{
    ARG_UNUSED(attr);

    static const uint8_t level = MLKEM_SEC_LEVEL;
    LOG("PQLVL read: level=0x%02x len=%u offset=%u", level, len, offset);
    return bt_gatt_attr_read(conn, attr, buf, len, offset, &level, sizeof(level));
}

static ssize_t write_cp(struct bt_conn *conn, const struct bt_gatt_attr *attr,
                        const void *buf, uint16_t len, uint16_t offset,
                        uint8_t flags)
{
    ARG_UNUSED(conn);
    ARG_UNUSED(attr);

    LOG("CP write request: len=%u offset=%u flags=0x%02x", len, offset, flags);

    if (offset != 0 || len != 1) {
        LOG("CP write rejected: expected len=1 offset=0");
        return BT_GATT_ERR(BT_ATT_ERR_INVALID_OFFSET);
    }

    uint8_t value;
    memcpy(&value, buf, sizeof(value));
    LOG("CP write value: 0x%02x", value);
    pqke_state_set_cp(value);
    return len;
}

static ssize_t write_ct(struct bt_conn *conn, const struct bt_gatt_attr *attr,
                        const void *buf, uint16_t len, uint16_t offset,
                        uint8_t flags)
{
    ARG_UNUSED(conn);
    ARG_UNUSED(attr);

    LOG("CT write request: len=%u offset=%u flags=0x%02x", len, offset, flags);
    return pqke_transfer_write_ciphertext_frame(buf, len, offset, flags);
}

static void ccc_cfg_changed(const struct bt_gatt_attr *attr, uint16_t value)
{
    ARG_UNUSED(attr);

    LOG("CCC changed: value=0x%04x", value);
}

static struct bt_gatt_cep ct_cep = {
    .properties = BT_GATT_CEP_RELIABLE_WRITE,
};

BT_GATT_SERVICE_DEFINE(vnd_svc,
    BT_GATT_PRIMARY_SERVICE(&vnd_uuid),
    BT_GATT_CHARACTERISTIC(&cp_uuid.uuid,
        BT_GATT_CHRC_READ | BT_GATT_CHRC_NOTIFY | BT_GATT_CHRC_WRITE,
        BT_GATT_PERM_READ | BT_GATT_PERM_WRITE,
        read_cp, write_cp, NULL),
    BT_GATT_CCC(ccc_cfg_changed, BT_GATT_PERM_READ | BT_GATT_PERM_WRITE),
    BT_GATT_CHARACTERISTIC(&ind_uuid.uuid,
        BT_GATT_CHRC_READ | BT_GATT_CHRC_INDICATE,
        BT_GATT_PERM_READ,
        read_cp, NULL, &ind_data),
    BT_GATT_CCC(ccc_cfg_changed, BT_GATT_PERM_READ | BT_GATT_PERM_WRITE),
    BT_GATT_CHARACTERISTIC(&ct_uuid.uuid,
        BT_GATT_CHRC_WRITE | BT_GATT_CHRC_EXT_PROP,
        BT_GATT_PERM_WRITE | BT_GATT_PERM_PREPARE_WRITE,
        NULL, write_ct, NULL),
    BT_GATT_CEP(&ct_cep),
    BT_GATT_CHARACTERISTIC(&pqlvl_uuid.uuid,
        BT_GATT_CHRC_READ,
        BT_GATT_PERM_READ,
        read_pqlvl, NULL, NULL),
);

static void mtu_updated(struct bt_conn *conn, uint16_t tx, uint16_t rx)
{
    LOG("MTU updated: TX=%u RX=%u ATT_MTU=%u", tx, rx, bt_gatt_get_mtu(conn));
}

static struct bt_gatt_cb gatt_callbacks = {
    .att_mtu_updated = mtu_updated,
};

static void radio_window_end_handler(struct k_work *work)
{
    ARG_UNUSED(work);

    radio_window_open = false;

    LOG("RADIO WINDOW END: active=%u ms; cutting advertising and connection",
        RADIO_ACTIVE_WINDOW_MS);

    (void)stop_advertising();

    if (current_conn) {
        int ret;

        LOG("disconnecting active CPQKE connection due to radio window end");
        ret = bt_conn_disconnect(current_conn, BT_HCI_ERR_REMOTE_USER_TERM_CONN);
        if (ret) {
            LOG("bt_conn_disconnect failed: err=%d", ret);
        }
    }

    k_work_schedule(&radio_window_start_work,
                    K_MSEC(RADIO_INACTIVE_WINDOW_MS));
}

static void radio_window_start_handler(struct k_work *work)
{
    int err;

    ARG_UNUSED(work);

    radio_window_open = true;

    LOG("RADIO WINDOW START: advertising for %u ms", RADIO_ACTIVE_WINDOW_MS);

    pqke_state_reset_to_idle_no_notify();

    err = start_advertising();
    if (err) {
        LOG("radio window start failed to start advertising: err=%d", err);
    }

    k_work_schedule(&radio_window_end_work,
                    K_MSEC(RADIO_ACTIVE_WINDOW_MS));
}

static void connected(struct bt_conn *conn, uint8_t err)
{
    int ret;

    if (err) {
        LOG("connection failed: err=0x%02x", err);
        return;
    }

    advertising_active = false;

    if (!radio_window_open) {
        LOG("connected outside radio window; disconnecting immediately");
        (void)bt_conn_disconnect(conn, BT_HCI_ERR_REMOTE_USER_TERM_CONN);
        return;
    }

    LOG("connected; ATT_MTU=%u", bt_gatt_get_mtu(conn));

    if (current_conn) {
        bt_conn_unref(current_conn);
    }
    current_conn = bt_conn_ref(conn);

    ret = bt_conn_le_param_update(conn, &pqke_conn_param);
    if (ret) {
        LOG("connection parameter update request failed: err=%d", ret);
    } else {
        LOG("connection parameter update requested: interval=[%u,%u], latency=%u, timeout=%u",
            pqke_conn_param.interval_min, pqke_conn_param.interval_max,
            pqke_conn_param.latency, pqke_conn_param.timeout);
    }
}

static void disconnected(struct bt_conn *conn, uint8_t reason)
{
    ARG_UNUSED(conn);

    LOG("disconnected: reason=0x%02x", reason);

    if (current_conn) {
        bt_conn_unref(current_conn);
        current_conn = NULL;
    }

    pqke_state_reset_to_idle_no_notify();

    if (radio_window_open) {
        LOG("radio window still open; restarting advertising");
        (void)start_advertising();
    } else {
        LOG("radio window closed; advertising remains off");
    }
}

BT_CONN_CB_DEFINE(conn_callbacks) = {
    .connected = connected,
    .disconnected = disconnected,
};

int ble_service_notify_cp(uint8_t value)
{
    if (!current_conn) {
        LOG("CP notify skipped: no active connection, value=0x%02x", value);
        return -ENOTCONN;
    }

    LOG("CP notify: value=0x%02x", value);
    int ret = bt_gatt_notify_uuid(current_conn, &cp_uuid.uuid, vnd_svc.attrs,
                                  &value, sizeof(value));
    if (ret) {
        LOG("CP notify failed: err=%d", ret);
    }
    return ret;
}

bool ble_service_has_connection(void)
{
    return current_conn != NULL;
}

int ble_service_disconnect(void)
{
    if (!current_conn) {
        LOG("disconnect requested but no active connection");
        return -ENOTCONN;
    }

    LOG("disconnect requested by protocol");
    return bt_conn_disconnect(current_conn, BT_HCI_ERR_REMOTE_USER_TERM_CONN);
}

const struct bt_gatt_attr *ble_service_public_key_indicate_attr(void)
{
    const struct bt_gatt_attr *attr;

    attr = bt_gatt_find_by_uuid(vnd_svc.attrs, vnd_svc.attr_count, &ind_uuid.uuid);
    if (!attr) {
        LOG("PK indication attribute lookup failed");
    }
    return attr;
}

int ble_service_init(void)
{
    int err;

    LOG("initialising connection-PQKE BLE service");
    LOG("KEM level=%u pk_len=%u ct_len=%u ct_frames=%u ct_frame_len=%u",
        MLKEM_SEC_LEVEL, (unsigned int)PQKE_PK_BYTES, (unsigned int)PQKE_CT_BYTES,
        (unsigned int)PQKE_CT_FRAMES, (unsigned int)PQKE_CT_FRAME_LEN);

    if (IS_ENABLED(CONFIG_SETTINGS)) {
        err = settings_load();
        if (err) {
            LOG("settings_load failed: err=%d", err);
        } else {
            LOG("settings loaded");
        }
    }

    bt_gatt_cb_register(&gatt_callbacks);
    LOG("GATT callbacks registered");

    k_work_init_delayable(&radio_window_end_work, radio_window_end_handler);
    k_work_init_delayable(&radio_window_start_work, radio_window_start_handler);

    radio_window_open = true;

    err = start_advertising();
    if (err) {
        return err;
    }

    k_work_schedule(&radio_window_end_work,
                    K_MSEC(RADIO_ACTIVE_WINDOW_MS));

    LOG("radio intermittence enabled: active=%u ms inactive=%u ms",
        RADIO_ACTIVE_WINDOW_MS, RADIO_INACTIVE_WINDOW_MS);

    return 0;
}
```

## src/debug_utils.c
```c
#include "debug_utils.h"

#include <zephyr/sys/printk.h>

void debug_print_bytes(const uint8_t *buf, size_t len)
{
    for (size_t i = 0; i < len; i++) {
        printk("%02x ", buf[i]);
    }
    printk("\n");
}
```

## src/pqke_crypto.c
```c
#include "pqke_crypto.h"
#include "debug_utils.h"

#include <zephyr/kernel.h>
#include <zephyr/sys/printk.h>

#define LOG(fmt, ...) \
    printk("[%8u ms] [CRYPTO] " fmt "\n", (uint32_t)k_uptime_get(), ##__VA_ARGS__)

#if MLKEM_SEC_LEVEL == 1
#define mlkem_keypair PQCLEAN_MLKEM512_CLEAN_crypto_kem_keypair
#define mlkem_dec     PQCLEAN_MLKEM512_CLEAN_crypto_kem_dec
#elif MLKEM_SEC_LEVEL == 3
#define mlkem_keypair PQCLEAN_MLKEM768_CLEAN_crypto_kem_keypair
#define mlkem_dec     PQCLEAN_MLKEM768_CLEAN_crypto_kem_dec
#elif MLKEM_SEC_LEVEL == 5
#define mlkem_keypair PQCLEAN_MLKEM1024_CLEAN_crypto_kem_keypair
#define mlkem_dec     PQCLEAN_MLKEM1024_CLEAN_crypto_kem_dec
#endif

static uint8_t pk[PQKE_PK_BYTES];
static uint8_t sk[PQKE_SK_BYTES];
static uint8_t ct[PQKE_CT_BYTES];
static uint8_t ss[PQKE_SS_BYTES];

int pqke_crypto_generate_keypair(void)
{
    LOG("ML-KEM keypair start: level=%u pk=%u sk=%u ct=%u ss=%u",
        MLKEM_SEC_LEVEL, (unsigned int)sizeof(pk), (unsigned int)sizeof(sk),
        (unsigned int)sizeof(ct), (unsigned int)sizeof(ss));

    uint32_t t0 = (uint32_t)k_uptime_get();
    int ret = mlkem_keypair(pk, sk);
    uint32_t t1 = (uint32_t)k_uptime_get();

    LOG("ML-KEM keypair done: ret=%d duration=%u ms", ret, t1 - t0);
    return ret;
}

int pqke_crypto_decapsulate(const uint8_t *ciphertext)
{
    LOG("ML-KEM decapsulation start: ct_len=%u", (unsigned int)sizeof(ct));

    uint32_t t0 = (uint32_t)k_uptime_get();
    int ret = mlkem_dec(ss, ciphertext, sk);
    uint32_t t1 = (uint32_t)k_uptime_get();

    if (ret != 0) {
        LOG("ML-KEM decapsulation failed: ret=%d duration=%u ms", ret, t1 - t0);
        return ret;
    }

    LOG("ML-KEM decapsulation done: duration=%u ms", t1 - t0);
    printk("[%8u ms] [CRYPTO] Shared Secret: ", (uint32_t)k_uptime_get());
    debug_print_bytes(ss, sizeof(ss));
    return 0;
}

const uint8_t *pqke_crypto_public_key(void)
{
    return pk;
}

size_t pqke_crypto_public_key_len(void)
{
    return sizeof(pk);
}

uint8_t *pqke_crypto_ciphertext_buffer(void)
{
    return ct;
}

size_t pqke_crypto_ciphertext_len(void)
{
    return sizeof(ct);
}

const uint8_t *pqke_crypto_shared_secret(void)
{
    return ss;
}

size_t pqke_crypto_shared_secret_len(void)
{
    return sizeof(ss);
}
```

## src/pqke_state.c
```c
#include "pqke_state.h"

#include <zephyr/kernel.h>
#include <zephyr/sys/printk.h>

#include "ble_service.h"
#include "opcodes.h"
#include "pqke_config.h"
#include "pqke_crypto.h"
#include "pqke_transfer.h"

#define LOG(fmt, ...) \
    printk("[%8u ms] [STATE] " fmt "\n", (uint32_t)k_uptime_get(), ##__VA_ARGS__)

K_SEM_DEFINE(cp_sem, 0, 1);

static uint8_t cp = CP_IDLE;

static const char *cp_name(uint8_t value)
{
    switch (value) {
    case CP_IDLE: return "CP_IDLE";
    case CP_PING: return "CP_PING";
    case CP_INIT: return "CP_INIT";
    case CP_KEY_READY: return "CP_KEY_READY";
    case CP_C_RECEIVED: return "CP_C_RECEIVED/CT_DONE";
    case CP_DECAP_DONE: return "CP_DECAP_DONE";
    case CP_ALL_DONE: return "CP_ALL_DONE";
    case CP_ERROR: return "CP_ERROR";
    default: return "CP_UNKNOWN";
    }
}

static void set_cp_value(uint8_t new_value, bool notify)
{
    uint8_t old_value = cp;

    cp = new_value;
    LOG("CP transition: 0x%02x (%s) -> 0x%02x (%s)%s",
        old_value, cp_name(old_value), new_value, cp_name(new_value),
        notify ? " + notify" : "");

    if (notify) {
        (void)ble_service_notify_cp(new_value);
    }
}

void pqke_state_set_cp(uint8_t new_value)
{
    LOG("CP command/event queued: 0x%02x (%s)", new_value, cp_name(new_value));
    cp = new_value;
    k_sem_give(&cp_sem);
}

uint8_t pqke_state_get_cp(void)
{
    return cp;
}

void pqke_state_reset_to_idle_no_notify(void)
{
    set_cp_value(CP_IDLE, false);
}

void pqke_opcode_thread(void)
{
    LOG("opcode thread started");

    while (1) {
        k_sem_take(&cp_sem, K_FOREVER);

        uint8_t event = cp;
        LOG("handling CP event: 0x%02x (%s)", event, cp_name(event));

        switch (event) {
        case CP_IDLE:
            LOG("idle event ignored");
            break;

        case CP_PING: {
            uint8_t resp = 0xff;
            LOG("ping received; sending 0xff response");
            (void)ble_service_notify_cp(resp);
            set_cp_value(CP_IDLE, false);
            break;
        }

        case CP_INIT: {
            LOG("key generation start: MLKEM_SEC_LEVEL=%u", MLKEM_SEC_LEVEL);
            uint32_t t0 = (uint32_t)k_uptime_get();
            int ret = pqke_crypto_generate_keypair();
            uint32_t t1 = (uint32_t)k_uptime_get();

            LOG("key generation finished: ret=%d duration=%u ms", ret, t1 - t0);
            if (ret != 0) {
                set_cp_value(CP_ERROR, true);
                break;
            }

            set_cp_value(CP_KEY_READY, true);

            LOG("public key indication start");
            t0 = (uint32_t)k_uptime_get();
            ret = pqke_transfer_deliver_public_key();
            t1 = (uint32_t)k_uptime_get();
            LOG("public key indication finished: ret=%d duration=%u ms", ret, t1 - t0);

            if (ret != 0) {
                set_cp_value(CP_ERROR, true);
                break;
            }

            /* Keep CP readable as KEY_READY until CT_DONE/CP_C_RECEIVED arrives. */
            break;
        }

        case CP_KEY_READY:
            LOG("CP_KEY_READY command received directly; re-sending status notification");
            set_cp_value(CP_KEY_READY, true);
            break;

        case CP_C_RECEIVED: {
            LOG("CT_DONE received; decapsulation start");
            uint32_t t0 = (uint32_t)k_uptime_get();
            int ret = pqke_crypto_decapsulate(pqke_crypto_ciphertext_buffer());
            uint32_t t1 = (uint32_t)k_uptime_get();
            LOG("decapsulation finished: ret=%d duration=%u ms", ret, t1 - t0);

            if (ret != 0) {
                set_cp_value(CP_ERROR, true);
                break;
            }

            set_cp_value(CP_DECAP_DONE, true);
            break;
        }

        case CP_DECAP_DONE:
            LOG("CP_DECAP_DONE command received directly; re-sending status notification");
            set_cp_value(CP_DECAP_DONE, true);
            break;

        case CP_ALL_DONE:
            LOG("session complete command received; disconnecting");
            (void)ble_service_disconnect();
            set_cp_value(CP_IDLE, false);
            break;

        default:
            LOG("unknown control opcode: 0x%02x", event);
            set_cp_value(CP_ERROR, true);
            break;
        }
    }
}

K_THREAD_DEFINE(pqke_opcode_thread_id,
                PQKE_OPCODE_THREAD_STACK_SIZE,
                pqke_opcode_thread,
                NULL, NULL, NULL,
                PQKE_OPCODE_THREAD_PRIORITY,
                0,
                0);
```

## src/pqke_transfer.c
```c
#include "pqke_transfer.h"

#include <errno.h>
#include <string.h>

#include <zephyr/kernel.h>
#include <zephyr/sys/printk.h>
#include <zephyr/sys/util.h>
#include <zephyr/bluetooth/gatt.h>

#include "ble_service.h"
#include "opcodes.h"
#include "pqke_config.h"
#include "pqke_crypto.h"
#include "pqke_state.h"

#define LOG(fmt, ...) \
    printk("[%8u ms] [XFER] " fmt "\n", (uint32_t)k_uptime_get(), ##__VA_ARGS__)

/*
 * Declared here to keep this experiment self-contained even if ble_service.h
 * has not yet been updated. Prefer moving this declaration into ble_service.h.
 */
bool ble_service_has_connection(void);

static uint8_t ct_frame[PQKE_CT_FRAME_LEN];
static struct bt_gatt_indicate_params pk_ind_params;
static bool indicating;
static bool ct_rx_started;
static uint32_t ct_rx_start_ms;

static void indicate_cb(struct bt_conn *conn, struct bt_gatt_indicate_params *params, uint8_t err)
{
    ARG_UNUSED(conn);
    ARG_UNUSED(params);

    if (err != 0U) {
        LOG("PK indication confirmation failed: err=%u", err);
    } else {
        LOG("PK indication confirmed by peer");
    }
}

static void indicate_destroy(struct bt_gatt_indicate_params *params)
{
    ARG_UNUSED(params);
    indicating = false;
}

int pqke_transfer_deliver_public_key(void)
{
    const uint8_t *pk = pqke_crypto_public_key();
    size_t remain_bytes = pqke_crypto_public_key_len();
    size_t total_len = remain_bytes;
    const struct bt_gatt_attr *ind_attr = ble_service_public_key_indicate_attr();
    uint32_t start_ms = (uint32_t)k_uptime_get();
    unsigned int chunk_no = 0;

    if (!ind_attr) {
        LOG("public-key indication characteristic not found");
        return -ENOENT;
    }

    LOG("public-key transfer begin: total=%u max_chunk=%u",
        (unsigned int)total_len, (unsigned int)PQKE_MAX_CHRC_BYTE);

    pk_ind_params.attr = ind_attr;
    pk_ind_params.func = indicate_cb;
    pk_ind_params.destroy = indicate_destroy;

    while (remain_bytes > 0) {
        if (indicating) {
            if (!ble_service_has_connection()) {
                LOG("PK indication aborted while waiting: no active connection");
                indicating = false;
                return -ENOTCONN;
            }

            k_msleep(10);
            continue;
        }

        if (!ble_service_has_connection()) {
            LOG("PK indication aborted before submit: no active connection");
            indicating = false;
            return -ENOTCONN;
        }

        size_t offset = total_len - remain_bytes;
        size_t chunk_len = MIN(remain_bytes, (size_t)PQKE_MAX_CHRC_BYTE);

        pk_ind_params.data = &pk[offset];
        pk_ind_params.len = chunk_len;

        int ret = bt_gatt_indicate(NULL, &pk_ind_params);
        if (ret == 0) {
            chunk_no++;
            LOG("PK indication submitted: chunk=%u offset=%u len=%u remaining_after=%u",
                chunk_no, (unsigned int)offset, (unsigned int)chunk_len,
                (unsigned int)(remain_bytes - chunk_len));
            indicating = true;
            remain_bytes -= chunk_len;
        } else {
            LOG("PK indication submit failed: err=%d", ret);

            if (!ble_service_has_connection() ||
                ret == -ENOTCONN || ret == -ECONNRESET || ret == -ESHUTDOWN) {
                LOG("PK indication aborted because connection is gone");
                indicating = false;
                return ret;
            }

            LOG("retrying PK indication");
            k_msleep(10);
        }
    }

    while (indicating) {
        if (!ble_service_has_connection()) {
            LOG("PK indication wait aborted: no active connection");
            indicating = false;
            return -ENOTCONN;
        }

        k_msleep(10);
    }

    LOG("public-key transfer complete: total=%u chunks=%u duration=%u ms",
        (unsigned int)total_len, chunk_no, (uint32_t)k_uptime_get() - start_ms);

    return 0;
}

ssize_t pqke_transfer_write_ciphertext_frame(const void *buf, uint16_t len, uint16_t offset, uint8_t flags)
{
    if (!ct_rx_started) {
        ct_rx_started = true;
        ct_rx_start_ms = (uint32_t)k_uptime_get();
        LOG("ciphertext receive begin: ct_len=%u frames=%u frame_len=%u",
            (unsigned int)pqke_crypto_ciphertext_len(),
            (unsigned int)PQKE_CT_FRAMES,
            (unsigned int)PQKE_CT_FRAME_LEN);
    }

    if (flags & BT_GATT_WRITE_FLAG_PREPARE) {
        LOG("prepare-write fragment accepted: len=%u offset=%u flags=0x%02x", len, offset, flags);
        return 0;
    }

    if (offset + len > sizeof(ct_frame)) {
        LOG("CT write rejected: offset=%u len=%u frame_len=%u", offset, len,
            (unsigned int)sizeof(ct_frame));
        return BT_GATT_ERR(BT_ATT_ERR_INVALID_OFFSET);
    }

    memcpy(ct_frame + offset, buf, len);
    LOG("CT frame buffer updated: offset=%u len=%u end=%u", offset, len, offset + len);

    /*
     * Compatibility mode for the original client: each frame carries CT payload
     * followed by one frame-number byte. The final write of a frame is detected
     * using the old offset + len + 64 >= frame_len heuristic.
     */
    if (offset + len + 64 >= sizeof(ct_frame)) {
        uint8_t ct_frame_no = ct_frame[offset + len - 1];
        LOG("CT frame boundary detected: frame_no=%u", ct_frame_no);

        if (ct_frame_no >= PQKE_CT_FRAMES) {
            LOG("invalid CT frame number: %u", ct_frame_no);
            return BT_GATT_ERR(BT_ATT_ERR_VALUE_NOT_ALLOWED);
        }

        uint8_t *ct = pqke_crypto_ciphertext_buffer();
        size_t ct_len = pqke_crypto_ciphertext_len();
        size_t frame_payload_len = PQKE_CT_FRAME_LEN - 1;
        size_t dst_offset = ct_frame_no * frame_payload_len;

        if (dst_offset >= ct_len) {
            LOG("invalid CT destination offset: frame_no=%u dst_offset=%u ct_len=%u",
                ct_frame_no, (unsigned int)dst_offset, (unsigned int)ct_len);
            return BT_GATT_ERR(BT_ATT_ERR_INVALID_OFFSET);
        }

        size_t remaining = ct_len - dst_offset;
        size_t copy_len = MIN(frame_payload_len, remaining);

        memcpy(ct + dst_offset, ct_frame, copy_len);
        LOG("CT frame copied: frame=%u dst_offset=%u copy_len=%u remaining_after=%u",
            ct_frame_no, (unsigned int)dst_offset, (unsigned int)copy_len,
            (unsigned int)(remaining - copy_len));

        if (ct_frame_no == PQKE_CT_FRAMES - 1) {
            LOG("last CT frame received; queuing CP_C_RECEIVED/CT_DONE; rx_duration=%u ms",
                (uint32_t)k_uptime_get() - ct_rx_start_ms);
            ct_rx_started = false;
            pqke_state_set_cp(CP_C_RECEIVED);
        }
    }

    return len;
}
```
